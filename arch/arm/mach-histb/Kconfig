## arch/arm/mach-histb/Kconfig
```kconfig
choice
	prompt "Select a HiSTB SoC"
	depends on ARCH_HISTB

config ARCH_HI3798MV2X
	bool "Hi3798M V2XX series SoC"
	select ARM64
	help
	  Support for Hi3798MV2XX series SoCs.

config ARCH_HI3798MV3X
	bool "Hi3798M V3XX series SoC"
	select ARM64
	help
	  Support for Hi3798MV3XX series SoCs.

endchoice

if ARCH_HI3798MV2X

choice
	prompt "Select a Hi3798M V2XX based board"

config TARGET_HC2910_2AGHD05
	bool "Skyworth HC2910 with board label 2AGHD05"
	help
	  Support for Skyworth HC2910 with board label 2AGHD05. This board features:
	  - Hisilicon Hi3798MV200 SoC (4xCortex-A53, Mali MP-450)
	  - 2GiB DRAM
	  - 8GiB eMMC, uSD slot
	  - Wifi and Bluetooth module
	  - 1x USB 2.0, 1x USB 3.0 host port
	  - HDMI
	  - SCI
	  - 3 LED - power, Wifi, Lock(?)
	  - 1x Fast Ethernet Controller, 1x GBe Ethernet Controller

endchoice

endif

if ARCH_HI3798MV3X

choice
	prompt "Select a Hi3798M V3XX based board"

config TARGET_X96Q_HI3798MV300
	bool "X96Q Hi3798MV300"
	help
	  Support for X96Q TV box based on HiSilicon Hi3798MV300.

endchoice

endif

source "board/skyworth/hc2910-2aghd05/Kconfig"
source "board/x96/x96q-hi3798mv300/Kconfig"
```

## board/x96/x96q-hi3798mv300/Kconfig
```kconfig
config SYS_BOARD
	string
	default "x96q-hi3798mv300" if TARGET_X96Q_HI3798MV300

config SYS_VENDOR
	string
	default "x96" if TARGET_X96Q_HI3798MV300

config SYS_SOC
	string
	default "hi3798mv300" if TARGET_X96Q_HI3798MV300
```

## configs/x96q_hi3798mv300_defconfig
```kconfig
CONFIG_ARM=y
CONFIG_POSITION_INDEPENDENT=y
CONFIG_ARCH_HISTB=y
CONFIG_ARCH_HI3798MV3X=y
CONFIG_TARGET_X96Q_HI3798MV300=y
CONFIG_SYS_BOARD="x96q-hi3798mv300"
CONFIG_SYS_VENDOR="x96"
CONFIG_SYS_SOC="hi3798mv300"

CONFIG_TEXT_BASE=0x00000000

CONFIG_SYS_MALLOC_LEN=0x1000000
CONFIG_SYS_MALLOC_F_LEN=0x4000

CONFIG_NR_DRAM_BANKS=1

CONFIG_DEFAULT_DEVICE_TREE="hi3798mv300-x96q"

CONFIG_SYS_LOAD_ADDR=0x02000000

CONFIG_IDENT_STRING=" X96Q Hi3798MV300"

CONFIG_COUNTER_FREQUENCY=24000000

# CONFIG_EXPERT is not set
# CONFIG_EFI_LOADER is not set

CONFIG_SYS_CBSIZE=512
CONFIG_SYS_PBSIZE=537

# CONFIG_DISPLAY_CPUINFO is not set

CONFIG_SYS_PROMPT="MV300# "

CONFIG_CMD_MEMINFO=y

CONFIG_ENV_IS_NOWHERE=y

CONFIG_NO_NET=n

CONFIG_DM=y
CONFIG_POWER=y

# CONFIG_GPIO is not set
# CONFIG_I2C is not set
# CONFIG_INPUT is not set

CONFIG_SPI=y
CONFIG_DM_SPI=y
CONFIG_PL022_SPI=y
CONFIG_CMD_SPI=y

CONFIG_CMD_MMC=y
CONFIG_MMC=y
CONFIG_DM_MMC=y

CONFIG_MMC_DW=y
CONFIG_MMC_DW_K3=y
CONFIG_MMC_DW_SNPS=y

CONFIG_CMD_PART=y
CONFIG_CMD_LSBLK=y

CONFIG_CMD_GPT=y
CONFIG_CMD_MBR=y

CONFIG_CMD_USB=y

CONFIG_USB=y
CONFIG_USB_EHCI_HCD=y
CONFIG_USB_EHCI_GENERIC=y
CONFIG_USB_OHCI_HCD=y
CONFIG_USB_OHCI_GENERIC=y
CONFIG_USB_STORAGE=y

CONFIG_CMD_EXT4=y
CONFIG_FS_EXT4=y

CONFIG_CMD_FS_GENERIC=y

CONFIG_CLK=y
CONFIG_CLK_HI3798MV300=y

CONFIG_DM_RESET=y
CONFIG_RESET=y
CONFIG_RESET_HISILICON=y

CONFIG_DM_REGULATOR=y

CONFIG_WDT=y
CONFIG_WDT_SP805=y
CONFIG_CMD_WDT=y
```
